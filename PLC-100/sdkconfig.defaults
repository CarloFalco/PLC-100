## PLC-100/sdkconfig.defaults
```kconfig
# Flash
CONFIG_ESPTOOLPY_FLASHSIZE_2MB=y
CONFIG_ESPTOOLPY_FLASHMODE_DIO=y
CONFIG_ESPTOOLPY_FLASHFREQ_80M=y

# Disable PSRAM (XIAO ESP32-C6 has none)
CONFIG_SPIRAM=n

# Zigbee requires larger task stack
CONFIG_MAIN_TASK_STACK_SIZE=8192

# Reduce log noise and size
CONFIG_LOG_DEFAULT_LEVEL_INFO=y
CONFIG_LOG_DEFAULT_LEVEL_DEBUG=n

# Use minimal PHY init
CONFIG_ESP_PHY_INIT_DATA_IN_PARTITION=y
```
